## tests/unit/test_shell/testcase.yaml
```yaml
tests:
  unit.shell:
    platform_allow: native_sim
    tags: shell phase1
    timeout: 60
```

## tests/unit/test_storage_mgr/testcase.yaml
```yaml
tests:
  unit.storage_mgr:
    platform_allow: native_sim
    tags: storage phase1
    timeout: 60
```

## tests/unit/test_system_mgr/testcase.yaml
```yaml
tests:
  unit.system_mgr:
    platform_allow: native_sim
    tags: system phase1
    timeout: 60
```
